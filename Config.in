## Config.in
```kconfig
menu "anbernic.linux"

menu "System"
  source "$BR2_EXTERNAL_ANBERNIC_PATH/package/anbernic/core/anbernic-system/Config.in"
  source "$BR2_EXTERNAL_ANBERNIC_PATH/package/anbernic/core/anbernic-configgen/Config.in"
  source "$BR2_EXTERNAL_ANBERNIC_PATH/package/anbernic/core/anbernic-desktopapps/Config.in"
  source "$BR2_EXTERNAL_ANBERNIC_PATH/package/anbernic/alllinuxfirmwares/Config.in"
  source "$BR2_EXTERNAL_ANBERNIC_PATH/package/anbernic/core/anbernic-splash/Config.in"
  source "$BR2_EXTERNAL_ANBERNIC_PATH/package/anbernic/core/anbernic-scripts/Config.in"
  source "$BR2_EXTERNAL_ANBERNIC_PATH/package/anbernic/core/anbernic-image/Config.in"
  source "$BR2_EXTERNAL_ANBERNIC_PATH/package/anbernic/core/anbernic-audio/Config.in"
  source "$BR2_EXTERNAL_ANBERNIC_PATH/package/anbernic/core/anbernic-bluetooth/Config.in"
  source "$BR2_EXTERNAL_ANBERNIC_PATH/package/anbernic/core/anbernic-notice/Config.in"
  source "$BR2_EXTERNAL_ANBERNIC_PATH/package/anbernic/core/anbernic-drminfo/Config.in"

  menu "Boot"
    source "$BR2_EXTERNAL_ANBERNIC_PATH/package/anbernic/boot/anbernic-initramfs/Config.in"
    source "$BR2_EXTERNAL_ANBERNIC_PATH/package/anbernic/boot/anbernic-syslinux-efi/Config.in"
    source "$BR2_EXTERNAL_ANBERNIC_PATH/package/anbernic/boot/uboot-odroid-xu4/Config.in"
    source "$BR2_EXTERNAL_ANBERNIC_PATH/package/anbernic/boot/uboot-odroid-goa/Config.in"
    source "$BR2_EXTERNAL_ANBERNIC_PATH/package/anbernic/boot/uboot-amlogic/Config.in"
    source "$BR2_EXTERNAL_ANBERNIC_PATH/package/anbernic/boot/uboot-odroid-n2/Config.in"
    source "$BR2_EXTERNAL_ANBERNIC_PATH/package/anbernic/boot/rockpro64-blobs/Config.in"
    source "$BR2_EXTERNAL_ANBERNIC_PATH/package/anbernic/boot/rock960-blobs/Config.in"
  endmenu

  menu "Toolchain"
    source "$BR2_EXTERNAL_ANBERNIC_PATH/package/anbernic/toolchain/toolchain-optional-linaro-aarch64/Config.in"
  endmenu

  menu "Fonts"
    source "$BR2_EXTERNAL_ANBERNIC_PATH/package/anbernic/fonts/nanum-font/Config.in"
  endmenu

  menu "Arch"
    source "$BR2_EXTERNAL_ANBERNIC_PATH/package/anbernic/arch/firmware-rockpro64/Config.in"
  endmenu

  menu "Gpu"
    source "$BR2_EXTERNAL_ANBERNIC_PATH/package/anbernic/gpu/android-headers/Config.in"
    source "$BR2_EXTERNAL_ANBERNIC_PATH/package/anbernic/gpu/gpu-aml/Config.in"
    source "$BR2_EXTERNAL_ANBERNIC_PATH/package/anbernic/gpu/mali-rk450/Config.in"
    source "$BR2_EXTERNAL_ANBERNIC_PATH/package/anbernic/gpu/mali-t620-wayland/Config.in"
    source "$BR2_EXTERNAL_ANBERNIC_PATH/package/anbernic/gpu/mali-T760/Config.in"
    source "$BR2_EXTERNAL_ANBERNIC_PATH/package/anbernic/gpu/mali-450/Config.in"
    source "$BR2_EXTERNAL_ANBERNIC_PATH/package/anbernic/gpu/mali-opengles-sdk/Config.in"
    source "$BR2_EXTERNAL_ANBERNIC_PATH/package/anbernic/gpu/mali-g52/Config.in"
    source "$BR2_EXTERNAL_ANBERNIC_PATH/package/anbernic/gpu/mali-bifrost-module/Config.in"
    source "$BR2_EXTERNAL_ANBERNIC_PATH/package/anbernic/gpu/mali-midgard-module/Config.in"
    source "$BR2_EXTERNAL_ANBERNIC_PATH/package/anbernic/gpu/mali-g31-gbm/Config.in"
    source "$BR2_EXTERNAL_ANBERNIC_PATH/package/anbernic/gpu/mali-g31/Config.in"
    source "$BR2_EXTERNAL_ANBERNIC_PATH/package/anbernic/gpu/anbernic-nvidia-driver/Config.in"
    source "$BR2_EXTERNAL_ANBERNIC_PATH/package/anbernic/gpu/rockchip-mpp/Config.in"
    source "$BR2_EXTERNAL_ANBERNIC_PATH/package/anbernic/gpu/vulkan/glslang/Config.in"
    source "$BR2_EXTERNAL_ANBERNIC_PATH/package/anbernic/gpu/vulkan/spirv-headers/Config.in"
    source "$BR2_EXTERNAL_ANBERNIC_PATH/package/anbernic/gpu/vulkan/vulkan-headers/Config.in"
    source "$BR2_EXTERNAL_ANBERNIC_PATH/package/anbernic/gpu/vulkan/vulkan-loader/Config.in"
    source "$BR2_EXTERNAL_ANBERNIC_PATH/package/anbernic/gpu/vulkan/vulkan-tools/Config.in"
    source "$BR2_EXTERNAL_ANBERNIC_PATH/package/anbernic/gpu/vulkan/vulkan-samples/Config.in"
  endmenu

  menu "Network"
    source "$BR2_EXTERNAL_ANBERNIC_PATH/package/anbernic/network/rtl8821ce/Config.in"
  endmenu

  menu "Device trees"
  endmenu
endmenu

menu "Emulationstation"
  source "$BR2_EXTERNAL_ANBERNIC_PATH/package/anbernic/emulationstation/anbernic-emulationstation/Config.in"
  source "$BR2_EXTERNAL_ANBERNIC_PATH/package/anbernic/emulationstation/anbernic-es-system/Config.in"
  source "$BR2_EXTERNAL_ANBERNIC_PATH/package/anbernic/emulationstation/es-theme-carbon/Config.in"
  source "$BR2_EXTERNAL_ANBERNIC_PATH/package/anbernic/emulationstation/es-background-musics/Config.in"
endmenu

menu "Controllers"
  source "$BR2_EXTERNAL_ANBERNIC_PATH/package/anbernic/controllers/db9_gpio_rpi/Config.in"
  source "$BR2_EXTERNAL_ANBERNIC_PATH/package/anbernic/controllers/gamecon_gpio_rpi/Config.in"
  source "$BR2_EXTERNAL_ANBERNIC_PATH/package/anbernic/controllers/mk_arcade_joystick_rpi/Config.in"
  source "$BR2_EXTERNAL_ANBERNIC_PATH/package/anbernic/controllers/qtsixa/Config.in"
  source "$BR2_EXTERNAL_ANBERNIC_PATH/package/anbernic/controllers/qtsixa-shanwan/Config.in"
  source "$BR2_EXTERNAL_ANBERNIC_PATH/package/anbernic/controllers/xarcade2jstick/Config.in"
  source "$BR2_EXTERNAL_ANBERNIC_PATH/package/anbernic/controllers/xboxdrv/Config.in"
  source "$BR2_EXTERNAL_ANBERNIC_PATH/package/anbernic/controllers/retrogame/Config.in"
endmenu

menu "Emulators"
  menu "Retroarch"
    source "$BR2_EXTERNAL_ANBERNIC_PATH/package/anbernic/emulators/retroarch/retroarch/Config.in"
    source "$BR2_EXTERNAL_ANBERNIC_PATH/package/anbernic/emulators/retroarch/retroarch-assets/Config.in"
    source "$BR2_EXTERNAL_ANBERNIC_PATH/package/anbernic/emulators/retroarch/anbernic-bezel/Config.in"
    menu "Shaders"
      source "$BR2_EXTERNAL_ANBERNIC_PATH/package/anbernic/emulators/retroarch/shaders/anbernic-shaders/Config.in"
      source "$BR2_EXTERNAL_ANBERNIC_PATH/package/anbernic/emulators/retroarch/shaders/common-shaders/Config.in"
      source "$BR2_EXTERNAL_ANBERNIC_PATH/package/anbernic/emulators/retroarch/shaders/slang-shaders/Config.in"
      source "$BR2_EXTERNAL_ANBERNIC_PATH/package/anbernic/emulators/retroarch/shaders/glsl-shaders/Config.in"
     endmenu
    menu "cores"
      source "$BR2_EXTERNAL_ANBERNIC_PATH/package/anbernic/emulators/retroarch/libretro/libretro-atari800/Config.in"
      source "$BR2_EXTERNAL_ANBERNIC_PATH/package/anbernic/emulators/retroarch/libretro/libretro-pocketsnes/Config.in"
      source "$BR2_EXTERNAL_ANBERNIC_PATH/package/anbernic/emulators/retroarch/libretro/libretro-beetle-vb/Config.in"
      source "$BR2_EXTERNAL_ANBERNIC_PATH/package/anbernic/emulators/retroarch/libretro/libretro-snes9x/Config.in"
      source "$BR2_EXTERNAL_ANBERNIC_PATH/package/anbernic/emulators/retroarch/libretro/libretro-snes9x-next/Config.in"
      source "$BR2_EXTERNAL_ANBERNIC_PATH/package/anbernic/emulators/retroarch/libretro/libretro-desmume/Config.in"
      source "$BR2_EXTERNAL_ANBERNIC_PATH/package/anbernic/emulators/retroarch/libretro/libretro-picodrive/Config.in"
      source "$BR2_EXTERNAL_ANBERNIC_PATH/package/anbernic/emulators/retroarch/libretro/libretro-genesisplusgx/Config.in"
      source "$BR2_EXTERNAL_ANBERNIC_PATH/package/anbernic/emulators/retroarch/libretro/libretro-blastem/Config.in"
      source "$BR2_EXTERNAL_ANBERNIC_PATH/package/anbernic/emulators/retroarch/libretro/libretro-gambatte/Config.in"
      source "$BR2_EXTERNAL_ANBERNIC_PATH/package/anbernic/emulators/retroarch/libretro/libretro-stella/Config.in"
      source "$BR2_EXTERNAL_ANBERNIC_PATH/package/anbernic/emulators/retroarch/libretro/libretro-pcsx/Config.in"
      source "$BR2_EXTERNAL_ANBERNIC_PATH/package/anbernic/emulators/retroarch/libretro/libretro-beetle-psx/Config.in"
      source "$BR2_EXTERNAL_ANBERNIC_PATH/package/anbernic/emulators/retroarch/libretro/libretro-beetle-saturn/Config.in"
      source "$BR2_EXTERNAL_ANBERNIC_PATH/package/anbernic/emulators/retroarch/libretro/libretro-fceumm/Config.in"
      source "$BR2_EXTERNAL_ANBERNIC_PATH/package/anbernic/emulators/retroarch/libretro/libretro-nestopia/Config.in"
      source "$BR2_EXTERNAL_ANBERNIC_PATH/package/anbernic/emulators/retroarch/libretro/libretro-imame/Config.in"
      source "$BR2_EXTERNAL_ANBERNIC_PATH/package/anbernic/emulators/retroarch/libretro/libretro-beetle-pce/Config.in"
      source "$BR2_EXTERNAL_ANBERNIC_PATH/package/anbernic/emulators/retroarch/libretro/libretro-beetle-pce-fast/Config.in"
      source "$BR2_EXTERNAL_ANBERNIC_PATH/package/anbernic/emulators/retroarch/libretro/libretro-beetle-pcfx/Config.in"
      source "$BR2_EXTERNAL_ANBERNIC_PATH/package/anbernic/emulators/retroarch/libretro/libretro-virtualjaguar/Config.in"
      source "$BR2_EXTERNAL_ANBERNIC_PATH/package/anbernic/emulators/retroarch/libretro/libretro-bluemsx/Config.in"
      source "$BR2_EXTERNAL_ANBERNIC_PATH/package/anbernic/emulators/retroarch/libretro/libretro-gpsp/Config.in"
      source "$BR2_EXTERNAL_ANBERNIC_PATH/package/anbernic/emulators/retroarch/libretro/libretro-fbneo/Config.in"
      source "$BR2_EXTERNAL_ANBERNIC_PATH/package/anbernic/emulators/retroarch/libretro/libretro-gw/Config.in"
      source "$BR2_EXTERNAL_ANBERNIC_PATH/package/anbernic/emulators/retroarch/libretro/libretro-prboom/Config.in"
      source "$BR2_EXTERNAL_ANBERNIC_PATH/package/anbernic/emulators/retroarch/libretro/libretro-mrboom/Config.in"
      source "$BR2_EXTERNAL_ANBERNIC_PATH/package/anbernic/emulators/retroarch/libretro/libretro-tyrquake/Config.in"
      source "$BR2_EXTERNAL_ANBERNIC_PATH/package/anbernic/emulators/retroarch/libretro/libretro-beetle-ngp/Config.in"
      source "$BR2_EXTERNAL_ANBERNIC_PATH/package/anbernic/emulators/retroarch/libretro/libretro-vecx/Config.in"
      source "$BR2_EXTERNAL_ANBERNIC_PATH/package/anbernic/emulators/retroarch/libretro/libretro-beetle-lynx/Config.in"
      source "$BR2_EXTERNAL_ANBERNIC_PATH/package/anbernic/emulators/retroarch/libretro/libretro-lutro/Config.in"
      source "$BR2_EXTERNAL_ANBERNIC_PATH/package/anbernic/emulators/retroarch/libretro/libretro-beetle-wswan/Config.in"
      source "$BR2_EXTERNAL_ANBERNIC_PATH/package/anbernic/emulators/retroarch/libretro/libretro-parallel-n64/Config.in"
      source "$BR2_EXTERNAL_ANBERNIC_PATH/package/anbernic/emulators/retroarch/libretro/libretro-beetle-supergrafx/Config.in"
      source "$BR2_EXTERNAL_ANBERNIC_PATH/package/anbernic/emulators/retroarch/libretro/libretro-nxengine/Config.in"
      source "$BR2_EXTERNAL_ANBERNIC_PATH/package/anbernic/emulators/retroarch/libretro/libretro-prosystem/Config.in"
      source "$BR2_EXTERNAL_ANBERNIC_PATH/package/anbernic/emulators/retroarch/libretro/libretro-tgbdual/Config.in"
      source "$BR2_EXTERNAL_ANBERNIC_PATH/package/anbernic/emulators/retroarch/libretro/libretro-mgba/Config.in"
      source "$BR2_EXTERNAL_ANBERNIC_PATH/package/anbernic/emulators/retroarch/libretro/libretro-mame2003-plus/Config.in"
      source "$BR2_EXTERNAL_ANBERNIC_PATH/package/anbernic/emulators/retroarch/libretro/libretro-mame2010/Config.in"
      source "$BR2_EXTERNAL_ANBERNIC_PATH/package/anbernic/emulators/retroarch/libretro/libretro-mesen/Config.in"
      source "$BR2_EXTERNAL_ANBERNIC_PATH/package/anbernic/emulators/retroarch/libretro/libretro-mesen-s/Config.in"
      source "$BR2_EXTERNAL_ANBERNIC_PATH/package/anbernic/emulators/retroarch/libretro/libretro-fuse/Config.in"
      source "$BR2_EXTERNAL_ANBERNIC_PATH/package/anbernic/emulators/retroarch/libretro/libretro-cap32/Config.in"
      source "$BR2_EXTERNAL_ANBERNIC_PATH/package/anbernic/emulators/retroarch/libretro/libretro-81/Config.in"
      source "$BR2_EXTERNAL_ANBERNIC_PATH/package/anbernic/emulators/retroarch/libretro/libretro-imageviewer/Config.in"
      source "$BR2_EXTERNAL_ANBERNIC_PATH/package/anbernic/emulators/retroarch/libretro/libretro-o2em/Config.in"
      source "$BR2_EXTERNAL_ANBERNIC_PATH/package/anbernic/emulators/retroarch/libretro/libretro-hatari/Config.in"
      source "$BR2_EXTERNAL_ANBERNIC_PATH/package/anbernic/emulators/retroarch/libretro/libretro-yabasanshiro/Config.in"
      source "$BR2_EXTERNAL_ANBERNIC_PATH/package/anbernic/emulators/retroarch/libretro/libretro-freeintv/Config.in"
      source "$BR2_EXTERNAL_ANBERNIC_PATH/package/anbernic/emulators/retroarch/libretro/libretro-cheats/Config.in"
      source "$BR2_EXTERNAL_ANBERNIC_PATH/package/anbernic/emulators/retroarch/libretro/libretro-mupen64plus-next/Config.in"
      source "$BR2_EXTERNAL_ANBERNIC_PATH/package/anbernic/emulators/retroarch/libretro/libretro-flycast/Config.in"
      source "$BR2_EXTERNAL_ANBERNIC_PATH/package/anbernic/emulators/retroarch/libretro/libretro-px68k/Config.in"
      source "$BR2_EXTERNAL_ANBERNIC_PATH/package/anbernic/emulators/retroarch/libretro/libretro-vice/Config.in"
      source "$BR2_EXTERNAL_ANBERNIC_PATH/package/anbernic/emulators/retroarch/libretro/libretro-vba-m/Config.in"
      source "$BR2_EXTERNAL_ANBERNIC_PATH/package/anbernic/emulators/retroarch/libretro/libretro-mame/Config.in"
      source "$BR2_EXTERNAL_ANBERNIC_PATH/package/anbernic/emulators/retroarch/libretro/libretro-hbmame/Config.in"
      source "$BR2_EXTERNAL_ANBERNIC_PATH/package/anbernic/emulators/retroarch/libretro/libretro-kronos/Config.in"
      source "$BR2_EXTERNAL_ANBERNIC_PATH/package/anbernic/emulators/retroarch/libretro/libretro-neocd/Config.in"
      source "$BR2_EXTERNAL_ANBERNIC_PATH/package/anbernic/emulators/retroarch/libretro/libretro-pokemini/Config.in"
      source "$BR2_EXTERNAL_ANBERNIC_PATH/package/anbernic/emulators/retroarch/libretro/libretro-handy/Config.in"
      source "$BR2_EXTERNAL_ANBERNIC_PATH/package/anbernic/emulators/retroarch/libretro/libretro-daphne/Config.in"
      source "$BR2_EXTERNAL_ANBERNIC_PATH/package/anbernic/emulators/retroarch/libretro/libretro-bsnes/Config.in"
      source "$BR2_EXTERNAL_ANBERNIC_PATH/package/anbernic/emulators/retroarch/libretro/libretro-citra/Config.in"
      source "$BR2_EXTERNAL_ANBERNIC_PATH/package/anbernic/emulators/retroarch/libretro/libretro-dosbox/Config.in"
      source "$BR2_EXTERNAL_ANBERNIC_PATH/package/anbernic/emulators/retroarch/libretro/libretro-scummvm/Config.in"
      source "$BR2_EXTERNAL_ANBERNIC_PATH/package/anbernic/emulators/retroarch/libretro/libretro-theodore/Config.in"
      source "$BR2_EXTERNAL_ANBERNIC_PATH/package/anbernic/emulators/retroarch/libretro/libretro-pc88/Config.in"
      source "$BR2_EXTERNAL_ANBERNIC_PATH/package/anbernic/emulators/retroarch/libretro/libretro-pc98/Config.in"
      source "$BR2_EXTERNAL_ANBERNIC_PATH/package/anbernic/emulators/retroarch/libretro/libretro-puae/Config.in"
      source "$BR2_EXTERNAL_ANBERNIC_PATH/package/anbernic/emulators/retroarch/libretro/libretro-ppsspp/Config.in"
      source "$BR2_EXTERNAL_ANBERNIC_PATH/package/anbernic/emulators/retroarch/libretro/libretro-opera/Config.in"
      source "$BR2_EXTERNAL_ANBERNIC_PATH/package/anbernic/emulators/retroarch/libretro/libretro-dolphin/Config.in"
      source "$BR2_EXTERNAL_ANBERNIC_PATH/package/anbernic/emulators/retroarch/libretro/libretro-duckstation/Config.in"
      source "$BR2_EXTERNAL_ANBERNIC_PATH/package/anbernic/emulators/retroarch/libretro/libretro-tic80/Config.in"
      source "$BR2_EXTERNAL_ANBERNIC_PATH/package/anbernic/emulators/retroarch/libretro/libretro-retro8/Config.in"
     endmenu
  endmenu

  source "$BR2_EXTERNAL_ANBERNIC_PATH/package/anbernic/emulators/amiberry/Config.in"
  source "$BR2_EXTERNAL_ANBERNIC_PATH/package/anbernic/emulators/dolphin-emu/Config.in"
  source "$BR2_EXTERNAL_ANBERNIC_PATH/package/anbernic/emulators/dosbox/Config.in"
  source "$BR2_EXTERNAL_ANBERNIC_PATH/package/anbernic/emulators/dosbox-staging/Config.in"
  source "$BR2_EXTERNAL_ANBERNIC_PATH/package/anbernic/emulators/dosbox-x/Config.in"
  source "$BR2_EXTERNAL_ANBERNIC_PATH/package/anbernic/emulators/fsuae/Config.in"
  source "$BR2_EXTERNAL_ANBERNIC_PATH/package/anbernic/emulators/linapple/Config.in"
  source "$BR2_EXTERNAL_ANBERNIC_PATH/package/anbernic/emulators/moonlight-embedded/Config.in"
  source "$BR2_EXTERNAL_ANBERNIC_PATH/package/anbernic/emulators/supermodel3/Config.in"
  source "$BR2_EXTERNAL_ANBERNIC_PATH/package/anbernic/emulators/mame/Config.in"
  source "$BR2_EXTERNAL_ANBERNIC_PATH/package/anbernic/emulators/melonds/Config.in"
  source "$BR2_EXTERNAL_ANBERNIC_PATH/package/anbernic/emulators/yuzu/Config.in"
  source "$BR2_EXTERNAL_ANBERNIC_PATH/package/anbernic/emulators/cannonball/Config.in"
  source "$BR2_EXTERNAL_ANBERNIC_PATH/package/anbernic/emulators/cemu/cemu/Config.in"
  source "$BR2_EXTERNAL_ANBERNIC_PATH/package/anbernic/emulators/cemu/cemu-hook/Config.in"
  source "$BR2_EXTERNAL_ANBERNIC_PATH/package/anbernic/emulators/cemu/cemutil/Config.in"
  source "$BR2_EXTERNAL_ANBERNIC_PATH/package/anbernic/emulators/drastic/Config.in"

  menu "mupen64plus"
    source "$BR2_EXTERNAL_ANBERNIC_PATH/package/anbernic/emulators/mupen64plus/mupen64plus-core/Config.in"
    source "$BR2_EXTERNAL_ANBERNIC_PATH/package/anbernic/emulators/mupen64plus/mupen64plus-uiconsole/Config.in"
    source "$BR2_EXTERNAL_ANBERNIC_PATH/package/anbernic/emulators/mupen64plus/mupen64plus-gles2/Config.in"
    source "$BR2_EXTERNAL_ANBERNIC_PATH/package/anbernic/emulators/mupen64plus/mupen64plus-video-glide64mk2/Config.in"
    source "$BR2_EXTERNAL_ANBERNIC_PATH/package/anbernic/emulators/mupen64plus/mupen64plus-video-rice/Config.in"
    source "$BR2_EXTERNAL_ANBERNIC_PATH/package/anbernic/emulators/mupen64plus/mupen64plus-omx/Config.in"
    source "$BR2_EXTERNAL_ANBERNIC_PATH/package/anbernic/emulators/mupen64plus/mupen64plus-input-sdl/Config.in"
    source "$BR2_EXTERNAL_ANBERNIC_PATH/package/anbernic/emulators/mupen64plus/mupen64plus-audio-sdl/Config.in"
    source "$BR2_EXTERNAL_ANBERNIC_PATH/package/anbernic/emulators/mupen64plus/mupen64plus-rsphle/Config.in"
    source "$BR2_EXTERNAL_ANBERNIC_PATH/package/anbernic/emulators/mupen64plus/mupen64plus-gliden64/Config.in"
    source "$BR2_EXTERNAL_ANBERNIC_PATH/package/anbernic/emulators/mupen64plus/mupen64plus-v20-gliden64/Config.in"
  endmenu

  source "$BR2_EXTERNAL_ANBERNIC_PATH/package/anbernic/emulators/pcsx2/Config.in"
  source "$BR2_EXTERNAL_ANBERNIC_PATH/package/anbernic/emulators/pcsx2_avx2/Config.in"
  source "$BR2_EXTERNAL_ANBERNIC_PATH/package/anbernic/emulators/pcsx2-x86/Config.in"
  source "$BR2_EXTERNAL_ANBERNIC_PATH/package/anbernic/emulators/wine/wine-lutris/Config.in"
  source "$BR2_EXTERNAL_ANBERNIC_PATH/package/anbernic/emulators/wine/wine-lutris-wow64_32/Config.in"
  source "$BR2_EXTERNAL_ANBERNIC_PATH/package/anbernic/emulators/wine-x86/Config.in"
  source "$BR2_EXTERNAL_ANBERNIC_PATH/package/anbernic/emulators/rpcs3/Config.in"
  source "$BR2_EXTERNAL_ANBERNIC_PATH/package/anbernic/emulators/ppsspp/Config.in"
  source "$BR2_EXTERNAL_ANBERNIC_PATH/package/anbernic/emulators/ppsspp15/Config.in"
  source "$BR2_EXTERNAL_ANBERNIC_PATH/package/anbernic/emulators/reicast/Config.in"
  source "$BR2_EXTERNAL_ANBERNIC_PATH/package/anbernic/emulators/flycast/Config.in"
  source "$BR2_EXTERNAL_ANBERNIC_PATH/package/anbernic/emulators/scummvm/Config.in"
  source "$BR2_EXTERNAL_ANBERNIC_PATH/package/anbernic/emulators/vice/Config.in"
  source "$BR2_EXTERNAL_ANBERNIC_PATH/package/anbernic/emulators/citra/Config.in"
  source "$BR2_EXTERNAL_ANBERNIC_PATH/package/anbernic/emulators/daphne/Config.in"
  source "$BR2_EXTERNAL_ANBERNIC_PATH/package/anbernic/emulators/duckstation/Config.in"
  source "$BR2_EXTERNAL_ANBERNIC_PATH/package/anbernic/emulators/openbor/openbor/Config.in"
  source "$BR2_EXTERNAL_ANBERNIC_PATH/package/anbernic/emulators/openbor/openbor4432/Config.in"
  source "$BR2_EXTERNAL_ANBERNIC_PATH/package/anbernic/emulators/wine/faudio/Config.in"
  source "$BR2_EXTERNAL_ANBERNIC_PATH/package/anbernic/emulators/wine/dxvk/Config.in"
  source "$BR2_EXTERNAL_ANBERNIC_PATH/package/anbernic/emulators/wine/vkd3d-proton/Config.in"
  source "$BR2_EXTERNAL_ANBERNIC_PATH/package/anbernic/emulators/wine/vkd3d/Config.in"
  source "$BR2_EXTERNAL_ANBERNIC_PATH/package/anbernic/emulators/wine/wine-mono/Config.in"
  source "$BR2_EXTERNAL_ANBERNIC_PATH/package/anbernic/emulators/python-pygame2/Config.in"
endmenu

menu "Kodi"
if BR2_PACKAGE_KODI
  source "$BR2_EXTERNAL_ANBERNIC_PATH/package/anbernic/kodi/kodi18-peripheral-joystick/Config.in"
  source "$BR2_EXTERNAL_ANBERNIC_PATH/package/anbernic/kodi/kodi18-resource-language-de_de/Config.in"
  source "$BR2_EXTERNAL_ANBERNIC_PATH/package/anbernic/kodi/kodi18-resource-language-es_es/Config.in"
  source "$BR2_EXTERNAL_ANBERNIC_PATH/package/anbernic/kodi/kodi18-resource-language-eu_es/Config.in"
  source "$BR2_EXTERNAL_ANBERNIC_PATH/package/anbernic/kodi/kodi18-resource-language-fr_fr/Config.in"
  source "$BR2_EXTERNAL_ANBERNIC_PATH/package/anbernic/kodi/kodi18-resource-language-it_it/Config.in"
  source "$BR2_EXTERNAL_ANBERNIC_PATH/package/anbernic/kodi/kodi18-resource-language-pt_br/Config.in"
  source "$BR2_EXTERNAL_ANBERNIC_PATH/package/anbernic/kodi/kodi18-resource-language-sv_se/Config.in"
  source "$BR2_EXTERNAL_ANBERNIC_PATH/package/anbernic/kodi/kodi18-resource-language-tr_tr/Config.in"
  source "$BR2_EXTERNAL_ANBERNIC_PATH/package/anbernic/kodi/kodi18-resource-language-zh_cn/Config.in"
endif

  source "$BR2_EXTERNAL_ANBERNIC_PATH/package/anbernic/kodi/kodi-superrepo-all/Config.in"
  source "$BR2_EXTERNAL_ANBERNIC_PATH/package/anbernic/kodi/kodi-superrepo-repositories/Config.in"
endmenu

menu "Utils"
  source "$BR2_EXTERNAL_ANBERNIC_PATH/package/anbernic/utils/raspi2png/Config.in"
  source "$BR2_EXTERNAL_ANBERNIC_PATH/package/anbernic/utils/gpicase/Config.in"
  source "$BR2_EXTERNAL_ANBERNIC_PATH/package/anbernic/utils/rpigpioswitch/Config.in"
  source "$BR2_EXTERNAL_ANBERNIC_PATH/package/anbernic/utils/jstest2/Config.in"
  source "$BR2_EXTERNAL_ANBERNIC_PATH/package/anbernic/utils/xosd/Config.in"
  source "$BR2_EXTERNAL_ANBERNIC_PATH/package/anbernic/utils/unclutter/Config.in"
  source "$BR2_EXTERNAL_ANBERNIC_PATH/package/anbernic/utils/roshambo-case/Config.in"
  source "$BR2_EXTERNAL_ANBERNIC_PATH/package/anbernic/utils/winbtrfs/Config.in"
  source "$BR2_EXTERNAL_ANBERNIC_PATH/package/anbernic/utils/fdupes/Config.in"
  source "$BR2_EXTERNAL_ANBERNIC_PATH/package/anbernic/utils/winetricks/Config.in"
  source "$BR2_EXTERNAL_ANBERNIC_PATH/package/anbernic/utils/anbernic-wine/Config.in"
  source "$BR2_EXTERNAL_ANBERNIC_PATH/package/anbernic/utils/anbernic-pygame/Config.in"
  source "$BR2_EXTERNAL_ANBERNIC_PATH/package/anbernic/utils/cabextract/Config.in"
  source "$BR2_EXTERNAL_ANBERNIC_PATH/package/anbernic/utils/pacman/Config.in"
  source "$BR2_EXTERNAL_ANBERNIC_PATH/package/anbernic/utils/xow/Config.in"
  source "$BR2_EXTERNAL_ANBERNIC_PATH/package/anbernic/utils/evmapy/Config.in"
  source "$BR2_EXTERNAL_ANBERNIC_PATH/package/anbernic/utils/evmapy-system-config/Config.in"
endmenu

menu "Libraries"
  source "$BR2_EXTERNAL_ANBERNIC_PATH/package/anbernic/libraries/capsimg/Config.in"
  source "$BR2_EXTERNAL_ANBERNIC_PATH/package/anbernic/libraries/libcapsimage/Config.in"
  source "$BR2_EXTERNAL_ANBERNIC_PATH/package/anbernic/libraries/libenet/Config.in"
  source "$BR2_EXTERNAL_ANBERNIC_PATH/package/anbernic/libraries/python-autobreadcrumbs/Config.in"
  source "$BR2_EXTERNAL_ANBERNIC_PATH/package/anbernic/libraries/python-rpigpio/Config.in"
  source "$BR2_EXTERNAL_ANBERNIC_PATH/package/anbernic/libraries/python2-gobject/Config.in"
  source "$BR2_EXTERNAL_ANBERNIC_PATH/package/anbernic/libraries/wxwidgets/Config.in"
  source "$BR2_EXTERNAL_ANBERNIC_PATH/package/anbernic/libraries/python-evdev/Config.in"
  source "$BR2_EXTERNAL_ANBERNIC_PATH/package/anbernic/libraries/libglvnd/Config.in"
  source "$BR2_EXTERNAL_ANBERNIC_PATH/package/anbernic/libraries/librga/Config.in"
  source "$BR2_EXTERNAL_ANBERNIC_PATH/package/anbernic/libraries/alsa-plugins/Config.in"
  source "$BR2_EXTERNAL_ANBERNIC_PATH/package/anbernic/libraries/catch2/Config.in"
endmenu

endmenu
```
