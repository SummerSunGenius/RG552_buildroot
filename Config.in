## package/anbernic/boot/anbernic-syslinux-efi/Config.in
```kconfig
config BR2_PACKAGE_ANBERNIC_SYSLINUX_EFI
    bool "anbernic-syslinux-efi"
    help
      Precompiled syslinux EFI binaries from Archlinux

      https://www.archlinux.org/packages/core/x86_64/syslinux/
```

## package/anbernic/core/anbernic-audio/Config.in
```kconfig
config BR2_PACKAGE_ANBERNIC_AUDIO
	bool "anbernic-audio"
	select BR2_PACKAGE_BLUEZ_ALSA
	select BR2_PACKAGE_ALSA_UTILS
	select BR2_PACKAGE_ALSA_UTILS_AMIXER
	select BR2_PACKAGE_ALSA_UTILS_APLAY
	select BR2_PACKAGE_ALSA_PLUGINS
	help
	  Audio support and scripts for anbernic.linux
```

## package/anbernic/core/anbernic-bluetooth/Config.in
```kconfig
config BR2_PACKAGE_ANBERNIC_BLUETOOTH
	bool "anbernic-bluetooth"

    	select BR2_PACKAGE_BLUEZ5_UTILS
    	select BR2_PACKAGE_BLUEZ5_UTILS_CLIENT
    	select BR2_PACKAGE_BLUEZ5_UTILS_TEST
    	select BR2_PACKAGE_BLUEZ5_UTILS_PLUGINS_SIXAXIS
    	select BR2_PACKAGE_BLUEZ5_UTILS_DEPRECATED
        select BR2_PACKAGE_UTIL_LINUX_RFKILL
    	help
	  Bluetooth support and scripts for anbernic.linux
```

## package/anbernic/core/anbernic-desktopapps/Config.in
```kconfig
config BR2_PACKAGE_ANBERNIC_DESKTOPAPPS
    bool "anbernic-desktopapps"
    depends on BR2_PACKAGE_XSERVER_XORG_SERVER
    depends on BR2_PACKAGE_PCMANFM # file manager
    help
      Anbernic desktop applications
```

## package/anbernic/core/anbernic-drminfo/Config.in
```kconfig
config BR2_PACKAGE_ANBERNIC_DRMINFO
       depends on BR2_PACKAGE_LIBDRM
       bool "anbernic-drminfo"
```

## package/anbernic/core/anbernic-image/Config.in
```kconfig
config BR2_PACKAGE_ANBERNIC_IMAGE
	bool "anbernic-image"
	select BR2_PACKAGE_HOST_GENIMAGE
	select BR2_PACKAGE_HOST_GENEXT2FS
	help
	  Utilities needed to build Anbernic.linux images
```

## package/anbernic/core/anbernic-notice/Config.in
```kconfig
config BR2_PACKAGE_ANBERNIC_NOTICE
    bool "anbernic-notice"
    help
      Anbernic pdf notice
```

## package/anbernic/core/anbernic-scripts/Config.in
```kconfig
config BR2_PACKAGE_ANBERNIC_SCRIPTS
	bool "anbernic-scripts"

	select BR2_PACKAGE_PCIUTILS
	select BR2_PACKAGE_PYTHON2_GOBJECT
	select BR2_PACKAGE_PYTHON
	select BR2_PACKAGE_JQ # for vulkan parsing

	help
	  Anbernic scripts
```

## package/anbernic/core/anbernic-splash/Config.in
```kconfig
config BR2_PACKAGE_ANBERNIC_SPLASH
    bool "anbernic-splash"

    select BR2_PACKAGE_FFMPEG_FFPLAY if BR2_PACKAGE_ANBERNIC_SPLASH_FFPLAY
    select BR2_PACKAGE_DEJAVU_SANS   if BR2_PACKAGE_ANBERNIC_SPLASH_OMXPLAYER
    select BR2_PACKAGE_OMXPLAYER     if BR2_PACKAGE_ANBERNIC_SPLASH_OMXPLAYER
    select BR2_PACKAGE_MPV           if BR2_PACKAGE_ANBERNIC_SPLASH_MPV
    select BR2_PACKAGE_LIBASS        if BR2_PACKAGE_ANBERNIC_SPLASH_MPV

    help
      Anbernic splash

choice
        prompt "splash type"
        default BR2_PACKAGE_ANBERNIC_SPLASH_IMAGE
        help
          Select anbernic.linux splash type

config BR2_PACKAGE_ANBERNIC_SPLASH_IMAGE
        bool "image"

config BR2_PACKAGE_ANBERNIC_SPLASH_ROTATE_IMAGE
        bool "rotate_image"

config BR2_PACKAGE_ANBERNIC_SPLASH_OMXPLAYER
        bool "omxplayer"

config BR2_PACKAGE_ANBERNIC_SPLASH_FFPLAY
        bool "ffplay"

config BR2_PACKAGE_ANBERNIC_SPLASH_MPV
        bool "mpv"

endchoice
```

## package/anbernic/emulationstation/anbernic-es-system/Config.in
```kconfig
config BR2_PACKAGE_ANBERNIC_ES_SYSTEM
        bool "anbernic-es-system"
	select BR2_PACKAGE_ANBERNIC_CONFIGGEN
        help
          Generates the es_system.cfg file and the roms folder
```

## package/anbernic/emulationstation/anbernic-theme/Config.in
```kconfig
config BR2_PACKAGE_ANBERNIC_THEME
	bool "EmulationStation theme Anbernic"
	help
	  https://github.com/SummerSunGenius/anbernic-theme.git
```

## package/anbernic/emulators/retroarch/anbernic-bezel/Config.in
```kconfig
config BR2_PACKAGE_ANBERNIC_BEZEL
        bool "anbernic bezel"
        help
          Anbernic bezel

	  https://github.com/batocera-linux/batocera-bezel
```

## package/anbernic/emulators/retroarch/shaders/anbernic-shaders/Config.in
```kconfig
config BR2_PACKAGE_ANBERNIC_SHADERS
        bool "anbernic shaders"
	depends on BR2_PACKAGE_RETROARCH
        select BR2_PACKAGE_GLSL_SHADERS
        help
          Anbernic shaders for retroarch
```

## package/anbernic/utils/anbernic-pygame/Config.in
```kconfig
config BR2_PACKAGE_ANBERNIC_PYGAME
	bool "anbernic-pygame"

	select BR2_PACKAGE_PYTHON_PYGAME2
	select BR2_PACKAGE_EVMAPY
```
